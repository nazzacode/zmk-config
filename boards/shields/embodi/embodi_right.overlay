/*
 * Copyright (c) 2020 Pete Johanson
 *
 * SPDX-License-Identifier: MIT
 */

#include "embodi.dtsi"

&default_transform {
    col-offset = <6>;
};

&kscan0 {
    col-gpios                        // (5 left thumb)
    = <&gpio1  0  GPIO_ACTIVE_HIGH>  //  6 thumb
    , <&gpio0 31  GPIO_ACTIVE_HIGH>  // 
    , <&gpio0 29  GPIO_ACTIVE_HIGH>  // 
    , <&gpio1 11  GPIO_ACTIVE_HIGH>  //  
    , <&gpio0 10  GPIO_ACTIVE_HIGH>  //  
    , <&gpio0  9  GPIO_ACTIVE_HIGH>; //  

	row-gpios 
	= <&gpio0  2 (GPIO_ACTIVE_HIGH | GPIO_PULL_DOWN)>  // row 0
	, <&gpio1 15 (GPIO_ACTIVE_HIGH | GPIO_PULL_DOWN)>  // row 1
	, <&gpio1 13 (GPIO_ACTIVE_HIGH | GPIO_PULL_DOWN)>; // row 2
};