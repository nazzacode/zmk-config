## boards/shields/embodi/Kconfig.defconfig
```kconfig
# Copyright (c) 2020 Pete Johanson
# SPDX-License-Identifier: MIT

# Both halves
if SHIELD_EMBODI_LEFT || SHIELD_EMBODI_RIGHT

config ZMK_SPLIT
    default y

if ZMK_DISPLAY

config I2C
    default y

# whats this?
config SSD1306
    default y

endif # ZMK_DISPLAY

endif # SHIELD_EMBODI_LEFT || SHIELD_EMBODI_RIGHT

# Left half specific
if SHIELD_EMBODI_RIGHT

config ZMK_KEYBOARD_NAME
    default "Embodi Keyboard"

config ZMK_SPLIT_ROLE_CENTRAL
    default y

endif # SHIELD_EMBODI_LEFT
```

## boards/shields/embodi/Kconfig.shield
```kconfig
# Copyright (c) 2020 Pete Johanson
# SPDX-License-Identifier: MIT

config SHIELD_EMBODI_LEFT
    def_bool $(shields_list_contains,embodi_left)

config SHIELD_EMBODI_RIGHT
    def_bool $(shields_list_contains,embodi_right)
```

## boards/shields/my_corne/Kconfig.shield
```kconfig
# Copyright (c) 2020 Pete Johanson
# SPDX-License-Identifier: MIT

config SHIELD_MYCORNE_LEFT
    def_bool $(shields_list_contains,my_corne_left)

config SHIELD_MYCORNE_RIGHT
    def_bool $(shields_list_contains,my_corne_right)
```

## config/west.yml
```yaml
manifest:
  remotes:
    - name: zmkfirmware
      url-base: https://github.com/zmkfirmware
    # do we need the second remote?
    - name: badjeff
      url-base: https://github.com/badjeff
  projects:
    - name: zmk
      remote: zmkfirmware
      revision: feat/pointers-move-scroll
      import: app/west.yml
    - name: zmk-pmw3610-driver
      remote: badjeff
      revision: main
  self:
    path: config
```
