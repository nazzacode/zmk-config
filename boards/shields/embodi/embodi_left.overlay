/*
 * Copyright (c) 2020 Pete Johanson
 *
 * SPDX-License-Identifier: MIT
 */

#include "embodi.dtsi"

//kscan0 is the keyboard scanner driver
&kscan0 {
    col-gpios 
    = <&gpio0 31  GPIO_ACTIVE_HIGH>  // 0 pinky
    , <&gpio0 29  GPIO_ACTIVE_HIGH>  // 1 ring
    , <&gpio0  2  GPIO_ACTIVE_HIGH>  // 2 middle
    , <&gpio0  9  GPIO_ACTIVE_HIGH>  // 3 index inside
    , <&gpio0 10  GPIO_ACTIVE_HIGH>  // 4 index outside
    , <&gpio1  0  GPIO_ACTIVE_HIGH>; // 5 thumb
                                     // ... (6 right thumb)

	row-gpios 
	= <&gpio1 11 (GPIO_ACTIVE_HIGH | GPIO_PULL_DOWN)>  // row 0
	, <&gpio1 13 (GPIO_ACTIVE_HIGH | GPIO_PULL_DOWN)>  // row 1
	, <&gpio1 15 (GPIO_ACTIVE_HIGH | GPIO_PULL_DOWN)>; // row 2
};