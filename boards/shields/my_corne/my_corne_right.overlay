/*
 * Copyright (c) 2020 Pete Johanson
 *
 * SPDX-License-Identifier: MIT
 */

#include "my_corne.dtsi"

&default_transform {
    col-offset = <6>;
};

&kscan0 {
    col-gpios = 
        <&gpio1  4  GPIO_ACTIVE_LOW>,
        <&gpio1  6  GPIO_ACTIVE_LOW>,
        <&gpio0 31  GPIO_ACTIVE_LOW>,
        <&gpio0 29  GPIO_ACTIVE_LOW>,
        <&gpio0  2  GPIO_ACTIVE_LOW>,
        <&gpio1 15  GPIO_ACTIVE_LOW>;
};
/*
// &five_column_transform {
//     col-offset = <6>;
// };

// &kscan0 {
//     col-gpios
//         = <&pro_micro 14 GPIO_ACTIVE_HIGH
//         , <&pro_micro 15 GPIO_ACTIVE_HIGH>
//         , <&pro_micro 18 GPIO_ACTIVE_HIGH>
//         , <&pro_micro 19 GPIO_ACTIVE_HIGH>
//         , <&pro_micro 20 GPIO_ACTIVE_HIGH>
//         , <&pro_micro 21 GPIO_ACTIVE_HIGH>
//         ;
// };
// &five_column_transform {
//     col-offset = <6>;
// };

// &kscan0 {
//     col-gpios
//         = <&pro_micro 14 GPIO_ACTIVE_HIGH>
//         , <&pro_micro 15 GPIO_ACTIVE_HIGH>
//         , <&pro_micro 18 GPIO_ACTIVE_HIGH>
//         , <&pro_micro 19 GPIO_ACTIVE_HIGH>
//         , <&pro_micro 20 GPIO_ACTIVE_HIGH>
//         , <&pro_micro 21 GPIO_ACTIVE_HIGH>
//         ;
// };
// &five_column_transform {
//     col-offset = <6>;
// };

// &kscan0 {
//     col-gpios
//         = <&pro_micro 14 GPIO_ACTIVE_HIGH>
//         , <&pro_micro 15 GPIO_ACTIVE_HIGH>
//         , <&pro_micro 18 GPIO_ACTIVE_HIGH>
//         , <&pro_micro 19 GPIO_ACTIVE_HIGH>
//         , <&pro_micro 20 GPIO_ACTIVE_HIGH>
//         , <&pro_micro 21 GPIO_ACTIVE_HIGH>
//         ;
// };
// &five_column_transform {
//     col-offset = <6>;
// };

// &kscan0 {
//     col-gpios
//         = <&pro_micro 14 GPIO_ACTIVE_HIGH>
//         , <&pro_micro 15 GPIO_ACTIVE_HIGH>
//         , <&pro_micro 18 GPIO_ACTIVE_HIGH>
//         , <&pro_micro 19 GPIO_ACTIVE_HIGH>
//         , <&pro_micro 20 GPIO_ACTIVE_HIGH>
//         , <&pro_micro 21 GPIO_ACTIVE_HIGH>
//         ;
// };
// &five_column_transform {
//     col-offset = <6>;
// };

// &kscan0 {
//     col-gpios
//         = <&pro_micro 14 GPIO_ACTIVE_HIGH>
//         , <&pro_micro 15 GPIO_ACTIVE_HIGH>
//         , <&pro_micro 18 GPIO_ACTIVE_HIGH>
//         , <&pro_micro 19 GPIO_ACTIVE_HIGH>
//         , <&pro_micro 20 GPIO_ACTIVE_HIGH>
//         , <&pro_micro 21 GPIO_ACTIVE_HIGH>
//         ;
// };
// &five_column_transform {
//     col-offset = <6>;
// };

// &kscan0 {
//     col-gpios
//         = <&pro_micro 14 GPIO_ACTIVE_HIGH>
//         , <&pro_micro 15 GPIO_ACTIVE_HIGH>
//         , <&pro_micro 18 GPIO_ACTIVE_HIGH>
//         , <&pro_micro 19 GPIO_ACTIVE_HIGH>
//         , <&pro_micro 20 GPIO_ACTIVE_HIGH>
//         , <&pro_micro 21 GPIO_ACTIVE_HIGH>
//         ;
// };
// &five_column_transform {
//     col-offset = <6>;
// };

// &kscan0 {
//     col-gpios
//         = <&pro_micro 14 GPIO_ACTIVE_HIGH>
//         , <&pro_micro 15 GPIO_ACTIVE_HIGH>
//         , <&pro_micro 18 GPIO_ACTIVE_HIGH>
//         , <&pro_micro 19 GPIO_ACTIVE_HIGH>
//         , <&pro_micro 20 GPIO_ACTIVE_HIGH>
//         , <&pro_micro 21 GPIO_ACTIVE_HIGH>
//         ;
// };
// &five_column_transform {
//     col-offset = <6>;
// };

// &kscan0 {
//     col-gpios
//         = <&pro_micro 14 GPIO_ACTIVE_HIGH>
//         , <&pro_micro 15 GPIO_ACTIVE_HIGH>
//         , <&pro_micro 18 GPIO_ACTIVE_HIGH>
//         , <&pro_micro 19 GPIO_ACTIVE_HIGH>
//         , <&pro_micro 20 GPIO_ACTIVE_HIGH>
//         , <&pro_micro 21 GPIO_ACTIVE_HIGH>
//         ;
// };
// &five_column_transform {
//     col-offset = <6>;
// };

// &kscan0 {
//     col-gpios
//         = <&pro_micro 14 GPIO_ACTIVE_HIGH>
//         , <&pro_micro 15 GPIO_ACTIVE_HIGH>
//         , <&pro_micro 18 GPIO_ACTIVE_HIGH>
//         , <&pro_micro 19 GPIO_ACTIVE_HIGH>
//         , <&pro_micro 20 GPIO_ACTIVE_HIGH>
//         , <&pro_micro 21 GPIO_ACTIVE_HIGH>
//         ;
// };
// &five_column_transform {
//     col-offset = <6>;
// };

// &kscan0 {
//     col-gpios
//         = <&pro_micro 14 GPIO_ACTIVE_HIGH>
//         , <&pro_micro 15 GPIO_ACTIVE_HIGH>
//         , <&pro_micro 18 GPIO_ACTIVE_HIGH>
//         , <&pro_micro 19 GPIO_ACTIVE_HIGH>
//         , <&pro_micro 20 GPIO_ACTIVE_HIGH>
//         , <&pro_micro 21 GPIO_ACTIVE_HIGH>
//         ;
// };
// &five_column_transform {
//     col-offset = <6>;
// };

// &kscan0 {
//     col-gpios
//         = <&pro_micro 14 GPIO_ACTIVE_HIGH>
//         , <&pro_micro 15 GPIO_ACTIVE_HIGH>
//         , <&pro_micro 18 GPIO_ACTIVE_HIGH>
//         , <&pro_micro 19 GPIO_ACTIVE_HIGH>
//         , <&pro_micro 20 GPIO_ACTIVE_HIGH>
//         , <&pro_micro 21 GPIO_ACTIVE_HIGH>
//         ;
// };
// &five_column_transform {
//     col-offset = <6>;
// };

// &kscan0 {
//     col-gpios
//         = <&pro_micro 14 GPIO_ACTIVE_HIGH>
//         , <&pro_micro 15 GPIO_ACTIVE_HIGH>
//         , <&pro_micro 18 GPIO_ACTIVE_HIGH>
//         , <&pro_micro 19 GPIO_ACTIVE_HIGH>
//         , <&pro_micro 20 GPIO_ACTIVE_HIGH>
//         , <&pro_micro 21 GPIO_ACTIVE_HIGH>
//         ;
// };
// &five_column_transform {
//     col-offset = <6>;
// };

// &kscan0 {
//     col-gpios
//         = <&pro_micro 14 GPIO_ACTIVE_HIGH>
//         , <&pro_micro 15 GPIO_ACTIVE_HIGH>
//         , <&pro_micro 18 GPIO_ACTIVE_HIGH>
//         , <&pro_micro 19 GPIO_ACTIVE_HIGH>
//         , <&pro_micro 20 GPIO_ACTIVE_HIGH>
//         , <&pro_micro 21 GPIO_ACTIVE_HIGH>
//         ;
// };
// &five_column_transform {
//     col-offset = <6>;
// };

// &kscan0 {
//     col-gpios
//         = <&pro_micro 14 GPIO_ACTIVE_HIGH>
//         , <&pro_micro 15 GPIO_ACTIVE_HIGH>
//         , <&pro_micro 18 GPIO_ACTIVE_HIGH>
//         , <&pro_micro 19 GPIO_ACTIVE_HIGH>
//         , <&pro_micro 20 GPIO_ACTIVE_HIGH>
//         , <&pro_micro 21 GPIO_ACTIVE_HIGH>
//         ;
// };
// &five_column_transform {
//     col-offset = <6>;
// };

// &kscan0 {
//     col-gpios
//         = <&pro_micro 14 GPIO_ACTIVE_HIGH>
//         , <&pro_micro 15 GPIO_ACTIVE_HIGH>
//         , <&pro_micro 18 GPIO_ACTIVE_HIGH>
//         , <&pro_micro 19 GPIO_ACTIVE_HIGH>
//         , <&pro_micro 20 GPIO_ACTIVE_HIGH>
//         , <&pro_micro 21 GPIO_ACTIVE_HIGH>
//         ;
// };